## firmware/main/Kconfig.projbuild
```kconfig
menu "logbo"

config LOGBO_GNSS_RATE_HZ
    int "GNSS navigation rate (Hz); one log row per epoch"
    range 1 25
    default 25
    help
        The NEO-M9N supports up to 25 Hz. If the receiver rejects the rate, 10 Hz is used.

config LOGBO_UDP_PORT
    int "UDP port the JSON datagrams are broadcast to"
    default 5005

config LOGBO_CPU_MIN_MHZ
    int "Minimum CPU frequency for dynamic frequency scaling (MHz)"
    default 80
    help
        One of 40, 80, 160, 240. The maximum is the default CPU frequency.

config LOGBO_CONFIG_WINDOW_S
    int "Seconds after boot during which the BLE config service is advertised (0 = always)"
    default 0
    help
        0 (the default) keeps the config service advertised all the time, so the Web Bluetooth page and
        tools/ble-config.py can connect whenever. A positive value stops advertising that long after boot
        (a client connected by then may stay until it disconnects).

endmenu
```
